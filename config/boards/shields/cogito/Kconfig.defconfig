## config/boards/shields/cogito/Kconfig.defconfig
```kconfig
# Copyright (c) 2022 The ZMK Contributors
# SPDX-License-Identifier: MIT

if SHIELD_COGITO_LEFT

config ZMK_KEYBOARD_NAME
    default "COGITO"
    
config ZMK_SPLIT_ROLE_CENTRAL
    default y

endif

if SHIELD_COGITO_LEFT || SHIELD_COGITO_RIGHT

config ZMK_SPLIT
    default y

endif
```

## config/boards/shields/cogito/Kconfig.shield
```kconfig
# Copyright (c) 2022 The ZMK Contributors
# SPDX-License-Identifier: MIT

config SHIELD_COGITO_LEFT
    def_bool $(shields_list_contains,cogito_left)

config SHIELD_COGITO_RIGHT
    def_bool $(shields_list_contains,cogito_right)
```
